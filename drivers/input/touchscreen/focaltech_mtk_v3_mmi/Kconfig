## drivers/input/touchscreen/focaltech_mtk_v3_mmi/Kconfig
```kconfig
#
# Focaltech Touchscreen driver configuration
#

config INPUT_TOUCHSCREEN_FTS_MTK_V3_MMI
    bool "Focaltech Touchscreen"
    default n
    help
      Say Y here if you have Focaltech touch panel.
      If unsure, say N.
```

## drivers/input/touchscreen/himax_mtk_mmi/Kconfig
```kconfig
config INPUT_TOUCHSCREEN_HIMAX_MTK_MMI
	bool "Support Motorola MediaTek Himax touch screen"
	depends on TOUCHSCREEN_MTK
	help
	  Say Y here if you wish to enable the Himax touch
	  screen driver.

	  If unsure, say N.
```
